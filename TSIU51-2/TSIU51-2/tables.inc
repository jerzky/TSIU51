/*
 * tables.inc
 *
 *  Created: 2019-02-14 18:49:32
 *   Author: Jensg
 */ 

FIRST_PULSE:	.db $10, $50, $01, $05, $11, $15, $51, $55
SECOND_PULSE:	.db $90, $40, $09, $04, $99, $94, $49, $44    
THIRD_PULSE:	.db $80, $60, $08, $06, $88, $86, $68, $66
FOURTH_PULSE:	.db $A0, $20, $0A, $02, $AA, $A2, $2A, $22
FIFTH_PULSE:	.db $20, $A0, $02, $0A, $22, $2A, $A2, $AA
SIXTH_PULSE:	.db $60, $80, $06, $08, $66, $68, $86, $88
SEVENTH_PULSE:	.db $40, $90, $04, $09, $44, $49, $94, $99
EIGHT_PULSE:	.db $50, $10, $05, $01, $55, $51, $15, $11

ALPHA_A: .db $80, $0E, $84, $02, $82, $04, $86, $02, $81, $06, $83, $08, $02, $08, $81, $08, $FF
ALPHA_B: .db $80, $10, $82, $06, $86, $02, $81, $04, $87, $02, $83, $06, $02, $06, $86, $02, $81, $04, $87, $02, $83, $06, $02, $08, $FF
ALPHA_C: .db $00, $04, $80, $08, $84, $04, $82, $04, $01, $10, $83, $04, $85, $04, $02, $08, $01, $04, $FF
ALPHA_D: .db $80, $10, $82, $06, $86, $02, $81, $0C, $87, $02, $83, $06, $02, $08, $FF
ALPHA_E: .db $80, $10, $82, $08, $01, $06, $83, $08, $01, $0A, $82, $08, $FF
ALPHA_F: .db $80, $10, $82, $08, $01, $06, $83, $08, $01, $0A, $02, $08, $FF
ALPHA_G: .db $00, $04, $80, $08, $84, $04, $82, $04, $01, $10, $83, $04, $85, $04, $02, $08, $01, $04, $80, $08, $83, $04, $02, $04, $01, $08, $FF
ALPHA_H: .db $80, $10, $01, $08, $82, $08, $80, $08, $01, $08, $81, $08, $FF
ALPHA_I: .db $02, $03, $82, $01, $80, $10, $83, $01, $02, $01, $82, $01, $01, $10, $83, $01, $02, $04, $FF


ALPHA_J: .db $00, $10, $82, $08, $81, $0E, $87, $02, $83, $04, $85, $02, $02, $08, $01, $02, $FF
ALPHA_K: .db $80, $10, $02, $07, $87, $08, $86, $08, $FF
ALPHA_L: .db $00, $10, $81, $10, $82, $08, $FF
ALPHA_M: .db $80, $10, $82, $01, $81, $02, $82, $01, $81, $02, $82, $01, $81, $02, $82, $01, $81, $02, $80, $02, $82, $01, $80, $02, $82, $01, $80, $02, $82, $01, $80, $02, $82, $01, $81, $10, $FF
ALPHA_N: .db $80, $10, $82, $01, $81, $02, $82, $01, $81, $02, $82, $01, $81, $02, $82, $01, $81, $02, $82, $01, $81, $02, $82, $01, $81, $02, $82, $01, $81, $02, $82, $01, $81, $02, $80, $10, $01, $10, $FF
ALPHA_O: .db $00, $02, $80, $0C, $84, $02, $82, $04, $86, $02, $81, $0C, $87, $02, $83, $04, $85, $02, $01, $02, $02, $08, $FF
ALPHA_P: .db $80, $10, $82, $06, $86, $02, $81, $04, $87, $02, $83, $06, $02, $08, $01, $08, $FF
ALPHA_Q: .db $00, $02, $80, $0C, $84, $02, $82, $04, $86, $02, $81, $0C, $87, $02, $83, $04, $85, $02, $01, $02, $02, $08, $85, $04, $06, $04, $FF
ALPHA_R: .db $80, $10, $82, $06, $86, $02, $81, $04, $87, $02, $83, $06, $86, $08, $FF
ALPHA_S: .db $00, $03, $86, $03, $82, $02, $84, $03, $80, $02, $85, $03, $83, $02, $85, $03, $80, $02, $84, $03, $82, $02, $86, $03, $01, $0C, $FF
ALPHA_T: .db $02, $04, $80, $0F, $03, $04, $82, $08, $03, $04, $01, $0F, $02, $04, $FF
ALPHA_U: .db $00, $10, $81, $0D, $86, $03, $82, $02, $84, $03, $80, $0D, $01, $10, $FF
ALPHA_V: .db $00, $10, $81, $04, $82, $01, $81, $04, $82, $01, $81, $04, $82, $01, $81, $04, $82, $02, $80, $04, $82, $01, $80, $04, $82, $01, $80, $04, $82, $01, $80, $04, $01, $10, $FF

ALPHA_W: .db $00, $10, $81, $10, $80, $02, $82, $01, $80, $02, $82, $01, $80, $02, $82, $01, $80, $02, $82, $02, $81, $02, $82, $01, $81, $02, $82, $01, $81, $02, $82, $01, $81, $02, $00, $10, $81, $10, $FF

ALPHA_X: .db $80, $04, $84, $08, $80, $04, $03, $08, $81, $04, $86, $08, $81, $04, $FF
ALPHA_Y: .db $02, $04, $80, $0A, $85, $04, $80, $02, $02, $08, $81, $02, $87, $04, $01, $0A, $02, $04, $FF
ALPHA_Z: .db $80, $02, $82, $01, $80, $02, $82, $01, $80, $02, $82, $01, $80, $02, $82, $01, $80, $02, $82, $01, $80, $02, $82, $01, $80, $02, $82, $01, $80, $02, $82, $01, $83, $08, $01, $10, $82, $08, $FF
ALPHA_OH:.db $80, $0E, $84, $02, $82, $01, $00, $02, $82, $04, $80, $03, $83, $04, $81, $03, $02, $01, $01, $02, $82, $03, $86, $02, $81, $06, $03, $08, $82, $08, $81, $08, $FF
ALPHA_EH:.db $80, $0E, $84, $02, $82, $01, $05, $02, $03, $01, $82, $02, $80, $02, $83, $02, $81, $02, $02, $07, $82, $02, $80, $02, $83, $02, $81, $02, $03, $04, $01, $02, $82, $04, $86, $02, $81, $06, $03, $08, $82, $08, $81, $08, $FF
ALPHA_OE:.db $00, $02, $80, $0C, $84, $02, $82, $01, $05, $02, $03, $01, $82, $02, $80, $02, $83, $02, $81, $02, $02, $06, $82, $02, $80, $02, $83, $02, $81, $02, $03, $03, $01, $02, $82, $03, $86, $02, $81, $0C, $87, $02, $83, $04, $85, $02, $06, $02, $02, $06, $01, $01, $FF


ALPHA_ALL: .dw  ALPHA_A, ALPHA_B, ALPHA_C, ALPHA_D, ALPHA_E, ALPHA_F, ALPHA_G, ALPHA_H, ALPHA_I, ALPHA_J, ALPHA_K, ALPHA_L, ALPHA_M, ALPHA_N, ALPHA_O, ALPHA_P, ALPHA_Q, ALPHA_R, ALPHA_S, ALPHA_T, ALPHA_U, ALPHA_V, ALPHA_W, ALPHA_X, ALPHA_Y, ALPHA_Z, ALPHA_OH, ALPHA_EH, ALPHA_OE, $FF


//Tabellen för kullen var ca 400 bytes- är ca 270 nu 
GRAPHIC_PLAT:		.db $80, $03, $82, $01, $80, $03, $82, $01, $80, $03, $82, $01, $80, $02, $82, $01, $80, $02, $82, $01, $80, $02, $82, $01, $80, $01, $82, $01, $80, $02, $82, $01, $80, $01, $82, $01, $80, $01, $82, $01, $80, $02, $82, $01, $80, $01, $82, $01, $80, $01, $82, $01, $80, $01, $82, $01, $80, $01, $82, $01, $80, $01, $82, $01, $80, $01, $82, $01, $80, $01, $82, $01, $80, $01, $82, $01, $80, $01, $82, $01, $80, $01, $82, $01, $80, $01, $82, $01, $80, $01, $82, $02, $80, $01, $82, $01, $80, $01, $82, $02, $80, $01, $82, $01, $80, $01, $82, $02, $80, $01, $82, $01, $80, $01, $82, $02, $80, $01, $82, $02, $80, $01, $82, $02, $80, $01, $82, $02, $80, $01, $82, $07, $82, $07, $81, $01, $82, $02, $81, $01, $82, $02, $81, $01, $82, $02, $81, $01, $82, $02, $81, $01, $82, $01, $81, $01, $82, $02, $81, $01, $82, $01, $81, $01, $82, $02, $81, $01, $82, $01, $81, $01, $82, $02, $81, $01, $82, $01, $81, $01, $82, $01, $81, $01, $82, $01, $81, $01, $82, $01, $81, $01, $82, $01, $81, $01, $82, $01, $81, $01, $82, $01, $81, $01, $82, $01, $81, $01, $82, $01, $81, $01, $82, $01, $81, $01, $82, $01, $81, $01, $82, $01, $81, $02, $82, $01, $81, $01, $82, $01, $81, $01, $82, $01, $81, $02, $82, $01, $81, $01, $82, $01, $81, $02, $82, $01, $81, $02, $82, $01, $81, $02, $82, $01, $81, $03, $82, $01, $81, $03, $82, $01, $81, $03, $03, $5C, $FF
GRAPHIC_PILLAR_1:	.db $02, $2E, $00, $2C, $80, $34, $01, $60, $03, $2E, $FF
GRAPHIC_PILLAR_2:	.db $02, $2E, $00, $2C, $00, $34, $82, $24, $03, $24, $01, $60, $03, $2E, $FF
GRAPHIC_PILLAR_3:	.db $02, $2E, $00, $2C, $00, $2A, $84, $0A, $07, $0A, $01, $56, $03, $2E, $FF
GRAPHIC_PILLAR_4:	.db $02, $2E, $00, $2C, $00, $34, $02, $24, $81, $0A, $03, $24, $01, $56, $03, $2E, $FF
GRAPHIC_HEAD:		.db $02, $2E, $00, $2C, $00, $34, $02, $24, $01, $0A, $82, $02, $81, $01, $82, $01, $81, $01, $82, $01, $81, $04, $83, $01, $81, $01, $83, $01, $81, $01, $83, $04, $80, $01, $83, $01, $80, $01, $83, $01, $80, $03, $80, $01, $82, $01, $80, $01, $82, $01, $80, $01, $82, $02, $03, $24, $01, $56, $03, $2E, $FF
GRAPHIC_BODY:		.db $02, $2E, $00, $60, $02, $24, $01, $12, $81, $10, $01, $3E, $03, $52, $FF
GRAPHIC_LEFT_LEG:	.db $02, $52, $00, $3E, $87, $08, $01, $36, $03, $4A, $FF
GRAPHIC_RIGHT_LEG:	.db $02, $52, $00, $3E, $86, $08, $01, $36, $03, $5A, $FF
GRAPHIC_LEFT_ARM:	.db $02, $52, $00, $48, $85, $08, $01, $50, $03, $4A, $FF
GRAPHIC_RIGHT_ARM:	.db $02, $52, $00, $48, $84, $08, $01, $50, $03, $5A, $FF

GRAPHICS_ALL: .dw  GRAPHIC_PLAT, GRAPHIC_PILLAR_1, GRAPHIC_PILLAR_2, GRAPHIC_PILLAR_3, GRAPHIC_PILLAR_4, GRAPHIC_HEAD, GRAPHIC_BODY, GRAPHIC_LEFT_LEG, GRAPHIC_RIGHT_LEG , GRAPHIC_LEFT_ARM, GRAPHIC_RIGHT_ARM, $FF

LETTERS_SETUP_START_POS:	.db$02, $B4, $00, $3C, $FF
LETTERS_SETUP_BACK_HOME:	.db$03, $B4, $01, $3C, $FF
LETTER_SUB:					.db$82, $0A, $02, $06, $FF
LETTER_SUB_BACK:			.db$03, $10, $FF

LETTERS_START_POS:			.db	$02, $B5, $00, $3E, $FF
LETTERS_BACK_HOME:			.db	$03, $B5, $01, $3E, $FF
LETTERS_MOVE_RIGHT:			.db $02, $10, $FF	
LETTERS_MOVE_RIGHT_LITTLE:	.db $02, $08, $FF	
LETTERS_MOVE_LEFT:			.db $03, $10, $FF	

WRONG_LETTERS_START_POS:		.db	$02, $B4, $FF
WRONG_LETTERS_BACK_HOME:		.db	$03, $B4, $FF
WRONG_LETTERS_MOVE_RIGHT:		.db $02, $0C, $FF	
WRONG_LETTERS_MOVE_LEFT:		.db $03, $10, $FF	
WRONG_LETTERS_MOVE_LITTLE_LEFT:	.db $03, $08, $FF